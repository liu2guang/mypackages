## LittlevGL2RTT/Kconfig
```kconfig
# Kconfig file for package LittlevGL2RTT
config PKG_USING_LITTLEVGL2RTT
    bool "LittlevGL2RTT: The LittlevGl gui lib adapter RT-Thread"
    default n

if PKG_USING_LITTLEVGL2RTT

    config PKG_LITTLEVGL2RTT_PATH
        string
        default "/packages/system/LittlevGL2RTT"

    choice
        prompt "LittlevGL2RTT version"
        help
            Select the LittlevGL2RTT version

        config PKG_USING_LITTLEVGL2RTT_V001
            bool "v0.0.1"

        config PKG_USING_LITTLEVGL2RTT_LATEST_VERSION
            bool "latest"
    endchoice
          
    config PKG_LITTLEVGL2RTT_VER
       string
       default "v0.0.1"    if PKG_USING_LITTLEVGL2RTT_V001
       default "latest"    if PKG_USING_LITTLEVGL2RTT_LATEST_VERSION

menu "LittlevGL2RTT Options"
    config LITTLEVGL2RTT_USING_DEMO
        bool
        prompt "LittlevGL2RTT demo example"
        default y
endmenu

endif
```

## clist/Kconfig
```kconfig
config PKG_USING_CLIST
    bool "clist: C doubly linked list implementation"
    default n

if PKG_USING_CLIST

    config PKG_CLIST_PATH
        string
        default "/packages/system/clist"

    config PKG_CLIST_VER
        string
        default "v1.0.0"

endif
```

## dwin/Kconfig
```kconfig
config PKG_USING_DWIN
    bool "dwin: c operation lib for dwin display screen"
    default n

if PKG_USING_DWIN

    config PKG_DWLIB_PATH
        string
        default "/packages/multimedia/dwin"

    config PKG_DWLIB_VER
        string
        default "v1.4.1"

config PKG_DWIN_DEBUG
    int
    prompt "Debug info output level"
    default 1

config PKG_DWIN_HEAD_H
    int
    prompt "Frame head high byte"
    default 0x5A

config PKG_DWIN_HEAD_L
    int
    prompt "Frame head low byte"
    default 0xA5

config PKG_DWIN_VAR_MAX_BYTE
    int
    prompt "Var space max byte"
    default 4096

config PKG_DWIN_WATCH_PRIO
    int
    prompt "Watcher thread prio"
    default 10

config PKG_DWIN_SPACE_NAME_LEN
    int
    prompt "Space name length"
    default 10

menu "Dwin Plugins Options"

    config PKG_DWIN_ENABLE_PLUGIN_ICON
        bool
        prompt "Enable plugin icon"
        default n

    config PKG_DWIN_ENABLE_PLUGIN_BUTTON
        bool
        prompt "Enable plugin button "
        default n

    config PKG_DWIN_BUTTON_PRESS_VALUE
	    int
	    depends on PKG_DWIN_ENABLE_PLUGIN_BUTTON
	    prompt "Button press value"
	    default 0x0D0D

    config PKG_DWIN_ENABLE_PLUGIN_TEXTBOX
        bool
        prompt "Enable plugin textbox "
        default n

    config PKG_DWIN_ENABLE_PLUGIN_INPUTBOX
        bool
        prompt "Enable plugin inputbox "
        default n

endmenu

endif
```

## dwlib/Kconfig
```kconfig
config PKG_USING_DWLIB
    bool "dwlib: c operation lib for dwin display screen"
    default n

if PKG_USING_DWLIB

    config PKG_DWLIB_PATH
        string
        default "/packages/multimedia/dwlib"

    config PKG_DWLIB_VER
        string
        default "v1.1.0-alpha"

choice
    prompt "Info print used api config"
    default PKG_DWLIB_PRINT_MODE_RTT

    config PKG_DWLIB_PRINT_RTT
        bool "RT-Thread"
    config PKG_DWLIB_PRINT_ELOG
        bool "EASYLOGGER"
    config PKG_DWLIB_PRINT_C
        bool "C-LIB"
endchoice

choice
    prompt "Memory manager used api config"
    default PKG_DWLIB_MM_RTT

    config PKG_DWLIB_MM_RTT
        bool "RT-Thread"
    config PKG_DWLIB_MM_C
        bool "C-LIB"
endchoice

menu "DWLIB Plugins Options"

    config PKG_DWLIB_ENABLE_SM
    bool
    prompt "Enable dwlib space manager plugins"
    default n

    config PKG_DWLIB_SM_NAME_LENGTH
    int
    prompt "Space manager name buffer length"
    default 8
    depends on PKG_DWLIB_ENABLE_SM

    config PKG_DWLIB_SM_SPACE_MAXSIZE
    int
    prompt "Space manager space addr max size"
    default 4096
    depends on PKG_DWLIB_ENABLE_SM
endmenu

endif
```

## lua2rtt/Kconfig
```kconfig
# Kconfig file for package lua2rtt
config PKG_USING_LUA2RTT
    bool "lua2rtt: The elua5.1.4 adapter RT-Thread"
    default n
    select RT_USING_LIBC if PKG_USING_LUA2RTT

if PKG_USING_LUA2RTT

    config PKG_LUA2RTT_PATH
        string
        default "/packages/language/lua2rtt"

    choice
        prompt "lua2rtt version"
        help
            Select the lua2rtt version

        config PKG_USING_LUA2RTT_LATEST_VERSION
            bool "latest"
    endchoice
          
    config PKG_LUA2RTT_VER
       string
       default "latest" if PKG_USING_LUA2RTT_LATEST_VERSION
endif
```

## multibutton/Kconfig
```kconfig
config PKG_USING_MULTIBUTTON
    bool "multibutton: event-driven button driver for embedded"
    default n

if PKG_USING_MULTIBUTTON

    config PKG_MULTIBUTTON_PATH
        string
        default "/packages/multimedia/multibutton"

    config PKG_MULTIBUTTON_VER
        string
        default "v1.0.0"

endif
```
